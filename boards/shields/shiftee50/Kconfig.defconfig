## boards/shields/shiftee50/Kconfig.defconfig
```kconfig
# Copyright (c) 2020 The ZMK Contributors
# SPDX-License-Identifier: MIT

if SHIELD_shiftee50

config ZMK_KEYBOARD_NAME
    default "shiftee50"

endif
```

## boards/shields/shiftee50/Kconfig.shield
```kconfig
# Copyright (c) 2020 The ZMK Contributors
# SPDX-License-Identifier: MIT

config SHIELD_shiftee50
    def_bool $(shields_list_contains,shiftee50)
```
